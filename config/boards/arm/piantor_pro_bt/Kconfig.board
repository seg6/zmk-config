## config/boards/arm/piantor_pro_bt/Kconfig.board
```kconfig
config BOARD_PIANTOR_PRO_BT_LEFT
	bool "Piantor Pro BT Left"
	depends on SOC_NRF52840_QIAA

config BOARD_PIANTOR_PRO_BT_RIGHT
    bool "Piantor Pro BT Right"
    depends on SOC_NRF52840_QIAA
```
